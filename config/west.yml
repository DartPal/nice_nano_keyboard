## config/west.yml
```yaml
manifest:
    remotes:
        - name: zmkfirmware
          url-base: https://github.com/zmkfirmware
    projects:
        - name: zmk
          remote: zmkfirmware
          revision: 517bfe9
          import: app/west.yml
    self:
        path: config
```
